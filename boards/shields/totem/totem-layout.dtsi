#include <physical_layouts.dtsi>

/ {
    totem_layout: totem_layout {
        compatible = "zmk,physical-layout";
        display-name = "Default";

        keys  //                     w   h    x    y     rot    rx    ry
            = <&key_physical_attrs 100 100 300  25  (-300)   146   81  >// 0,2
            , <&key_physical_attrs 100 100 900  0   0        0     0   >// 4,2
            , <&key_physical_attrs 100 100 1500  100 (-100)   200   300 >// 0,3
            , <&key_physical_attrs 100 100 1700  150  100     0     0   >// 4,3
            , <&key_physical_attrs 100 100 1900  200 (-200)   150   400 >// 0,4
            , <&key_physical_attrs 100 100 2100  250  300     0     0   >// 4,4
            , <&key_physical_attrs 100 100 300  100 (-400)   180   300 >// 1,2
            , <&key_physical_attrs 100 100 600  100  100     0     0   >// 5,2
            , <&key_physical_attrs 100 100 800  0   (-200)   200   100 >// 1,3
            , <&key_physical_attrs 100 100 1000  0   300     0     0   >// 5,3
            , <&key_physical_attrs 100 100 1200  200  200     0     0   >// 1,4
            , <&key_physical_attrs 100 100 1400  0   300     0     0   >// 5,4
            , <&key_physical_attrs 100 100 3500  10 (-900)   185   25  >// 2,2
            , <&key_physical_attrs 100 100 4000  15  (-600)  0     0    >// 6,2
            , <&key_physical_attrs 100 100 4300  10  (-20)   100   500 >// 2,3
            , <&key_physical_attrs 100 100 5000  35   (-50)  0     0    >// 6,3
            , <&key_physical_attrs 100 100 5400  10   (-100)  150   200 >// 2,4
            , <&key_physical_attrs 100 100 5900  15   (-250)  0     0    >// 6,4
            , <&key_physical_attrs 100 100 7600  20  450  200  150  >// 3,2
            , <&key_physical_attrs 100 100 8000  30  450   150  0    >// 7,2
            , <&key_physical_attrs 100 100 3500  30   700   0    300  >// 3,1
            , <&key_physical_attrs 100 100 4900  20  400    300   50  >// 3,0
            ;
    };
};
