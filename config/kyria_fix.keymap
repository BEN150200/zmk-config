/*
 * Copyright (c) 2020 The ZMK Contributors
 *
 * SPDX-License-Identifier: MIT
 */

#include <behaviors.dtsi>
#include <dt-bindings/zmk/keys.h>
#include <dt-bindings/zmk/bt.h>

#include <dt-bindings/zmk/outputs.h>
#include <dt-bindings/zmk/ext_power.h> 
#include <dt-bindings/zmk/rgb.h>

// Helpers for Spanish layout  
#include "keys_es.h" 

// urob/zmk-helpers module imports to allow better sintax
#include "zmk-helpers/helper.h"
#include "zmk-helpers/key-labels/kyria.h"

// urob/zmk-auto-layer module imports
#include <behaviors/num_word.dtsi>

// Layers definitions
#define DEF 0
#define SYM 1
#define NUM 2
#define FUN 3 

#define XXX &none
#define ___ &trans

/* Global settings */

#define QUICK_TAP_MS 175

&sk {  // sticky-key config
    release-after-ms = <900>;  // release after 0.6s
    quick-release;             // no double capitalization when rolling keys
};

&sl {  // sticky-layer config
    ignore-modifiers;          // allow chording sticky mods & layers
};

&lt {  // layer-tap config
    flavor = "balanced";
    tapping-term-ms = <200>;
    quick-tap-ms = <QUICK_TAP_MS>;
};

/* Timeless homerow mods */
#define KEYS_L LT0 LT1 LT2 LT3 LT4 LT5 LM0 LM1 LM2 LM3 LM4 LM5 LB0 LB1 LB2 LB3 LB4 LB5  // left hand
#define KEYS_R RT0 RT1 RT2 RT3 RT4 RT5 RM0 RM1 RM2 RM3 RM4 RM5 RB0 RB1 RB2 RB3 RB4 RB5  // right hand
#define EXTRA  LF1 LF0 RF0 RF1                                                          // extra keys
#define THUMBS LH4 LH3 LH2 LH1 LH0 RH0 RH1 RH2 RH3 RH4                                  // thumbs

#define MAKE_HRM(NAME, HOLD, TAP, TRIGGER_POS) \
    ZMK_HOLD_TAP(NAME, \
        flavor = "balanced"; \
        tapping-term-ms = <280>; \
        quick-tap-ms = <QUICK_TAP_MS>; \
        require-prior-idle-ms = <150>; \
        bindings = <HOLD>, <TAP>; \
        hold-trigger-key-positions = <TRIGGER_POS>; \
        hold-trigger-on-release; \
    )

MAKE_HRM(hml, &kp, &kp, KEYS_R THUMBS)  // left-hand HRMs
MAKE_HRM(hmr, &kp, &kp, KEYS_L THUMBS)  // right-hand HRMs

/* Caps-word, num-word */
/*
// tap: sticky-shift | shift + tap/ double-tap: caps-word | hold: shift
ZMK_MOD_MORPH(smart_shft,
    bindings = <&sk LSHFT>, <&caps_word>;
    mods = <(MOD_LSFT)>;
)
&caps_word {  // mods deactivate caps-word, requires PR #1451
    ignore-modifiers;  
};
*/


// tap: num-word | double-tap: sticky num-layer | hold: num-layer
#define SMART_NUM &smart_num NUM 0
ZMK_HOLD_TAP(smart_num,
    flavor = "balanced";
    tapping-term-ms = <200>;
    quick-tap-ms = <QUICK_TAP_MS>;
    bindings = <&mo>, <&num_dance>;
)
ZMK_TAP_DANCE(num_dance,
    tapping-term-ms = <200>;
    bindings = <&num_word NUM>, <&sl NUM>;  // reverse this for sticky-num on single tap
)


/* Custom behaviors */
/*
// tap: backspace | lshft + tap: delete | rshft + tap: shift-delete
ZMK_MOD_MORPH(bs_del,
    bindings = <&kp BSPC>, <&kp DEL>;
    mods = <(MOD_LSFT|MOD_RSFT)>;
    keep-mods = <MOD_RSFT>;
)
*/

/*
// tap: copy | double-tap: cut
ZMK_TAP_DANCE(copy_cut,
    tapping-term-ms = <200>;
    bindings = <&kp LC(INS)>, <&kp LC(X)>;
)
*/

// combos
#define COMBO_TERM_FAST 18
#define COMBO_TERM_SLOW 30

#define COMBO_IDLE_FAST 150
#define COMBO_IDLE_SLOW 50

ZMK_COMBO(cut,   &kp LC(X),    LB3 LB1,     DEF NUM, COMBO_TERM_FAST, COMBO_IDLE_FAST)
ZMK_COMBO(copy,  &kp LC(INS),  LB3 LB2,     DEF NUM, COMBO_TERM_FAST, COMBO_IDLE_FAST)
ZMK_COMBO(paste, &kp LS(INS),  LB2 LB1,     DEF NUM, COMBO_TERM_FAST, COMBO_IDLE_FAST)

/*
ZMK_COMBO(copy_cut, &copy_cut,   LB2 LB3, ALL)  // copy on tap, cut on double-tap, active on all layers
ZMK_COMBO(paste,    &kp LS(INS), LB1 LB2, ALL)  // paste, active on all layers
*/

// ---------------------------------------------------------------------------------------------------------------------------------
//  ╭─────┬─────┬─────┬─────┬─────┬─────╮                         ╭─────┬─────┬─────┬─────┬─────┬─────╮
//  | ESC |  Q  |  W  |  E  |  R  |  T  |                         |  Y  |  U  |  I  |  O  |  P  |BSPC |
//  ├─────┼─────┼─────┼─────┼─────┼─────┤                         ├─────┼─────┼─────┼─────┼─────┼─────┤
//  | TAB |  A  |  S  |  D  |  F  |  G  |                         |  H  |  J  |  K  |  L  |  Ñ  | RET |
//  ├─────┼─────┼─────┼─────┼─────┼─────┼─────┬─────╮ ╭─────┬─────┼─────┼─────┼─────┼─────┼─────┼─────┤
//  |SHIFT|  Z  |  X  |  C  |  V  |  B  |     |     | |     |     |  N  |  M  | , ; | . : | - _ |SHIFT|
//  ╰─────┴─────┴─────┼─────┼─────┼─────┼─────┼─────┤ ├─────┼─────┼─────┼─────┼─────┼─────┴─────┴─────╯
//                    |     | GUI |CTRL |SPACE| LY1 | | LY2 |SPACE| ALT | LY3 |     |
//                    ╰─────┴─────┴─────┴─────┴─────╯ ╰─────┴─────┴─────┴─────┴─────╯
ZMK_LAYER(default_layer, 
    // ╭─────────────┬─────────────┬─────────────┬─────────────┬─────────────┬─────────────╮                                                            ╭─────────────┬─────────────┬─────────────┬─────────────┬─────────────┬─────────────╮
         &kp ESC       &kp Q         &kp W         &kp E         &kp R         &kp T                                                                      &kp Y         &kp U         &kp I         &kp O         &kp P         &kp BSPC
    // ├─────────────┼─────────────┼─────────────┼─────────────┼─────────────┼─────────────┤                                                            ├─────────────┼─────────────┼─────────────┼─────────────┼─────────────┼─────────────┤
         &kp TAB       &kp A         &hml LALT S   &hml LSHFT D  &hml LCTRL F  &kp G                                                                      &kp H         &hmr LCTRL J  &hmr LSHFT K  &hmr LALT L   &hmr LGUI ES_N_TILDE &kp RET
    // ├─────────────┼─────────────┼─────────────┼─────────────┼─────────────┼─────────────┼─────────────┬─────────────╮    ╭─────────────┬─────────────┼─────────────┼─────────────┼─────────────┼─────────────┼─────────────┼─────────────┤
         &kp LSHFT     &kp Z         &kp X         &kp C         &kp V         &kp B         XXX           XXX                XXX           XXX           &kp N         &kp M         &kp ES_COMMA  &kp ES_DOT    &kp ES_MINUS  &kp RSHFT
    // ╰─────────────┴─────────────┴─────────────┼─────────────┼─────────────┼─────────────┼─────────────┼─────────────┤    ├─────────────┼─────────────┼─────────────┼─────────────┼─────────────┼─────────────┴─────────────┴─────────────╯
                                                   XXX           &kp LGUI      &kp LCTRL     &kp SPACE     &mo SYM            SMART_NUM     &kp SPACE     &kp LALT      &mo FUN       XXX
    //                                           ╰─────────────┴─────────────┴─────────────┴─────────────┴─────────────╯    ╰─────────────┴─────────────┴─────────────┴─────────────┴─────────────╯
    // Sensors
        , &inc_dec_kp C_VOL_UP C_VOL_DN &inc_dec_kp PG_UP PG_DN
)

// ---------------------------------------------------------------------------------------------------------------------------------
//  ╭─────┬─────┬─────┬─────┬─────┬─────╮                         ╭─────┬─────┬─────┬─────┬─────┬─────╮
//  |  º  |  !  |  @  |  #  |  $  |  %  |                         |  /  |  (  |  )  |  =  |  ?  |  ▼  |
//  ├─────┼─────┼─────┼─────┼─────┼─────┤                         ├─────┼─────┼─────┼─────┼─────┼─────┤
//  |  ª  |  ¡  |  `  |  "  |  '  |  &  |                         |  \  |  {  |  }  |  ^  |  ¿  |  ¨  |
//  ├─────┼─────┼─────┼─────┼─────┼─────┼─────┬─────╮ ╭─────┬─────┼─────┼─────┼─────┼─────┼─────┼─────┤
//  |  ▼  |  .  |  ´  |  <  |  >  |  |  |     |     | |     |     |  Ç  |  [  |  ]  |  ~  |  ¬  |  ▼  |
//  ╰─────┴─────┴─────┼─────┼─────┼─────┼─────┼─────┤ ├─────┼─────┼─────┼─────┼─────┼─────┴─────┴─────╯
//                    |  ▼  |  ▼  |  ▼  |  ▼  |  ▼  | |  ▼  |  ▼  |  ▼  |  ▼  |  ▼  |
//                    ╰─────┴─────┴─────┴─────┴─────╯ ╰─────┴─────┴─────┴─────┴─────╯
ZMK_LAYER(symbol_layer,
    // ╭─────────────┬─────────────┬─────────────┬─────────────┬─────────────┬─────────────╮                                                            ╭─────────────┬─────────────┬─────────────┬─────────────┬─────────────┬─────────────╮
         &kp ES_ORDM   &kp ES_EXCL   &kp ES_AT     &kp ES_HASH   &kp ES_DLLR   &kp ES_PRCNT                                                               &kp ES_FSLH   &kp ES_LPAR   &kp ES_RPAR   &kp ES_EQUAL  &kp ES_QMARK  ___
    // ├─────────────┼─────────────┼─────────────┼─────────────┼─────────────┼─────────────┤                                                            ├─────────────┼─────────────┼─────────────┼─────────────┼─────────────┼─────────────┤
         &kp ES_ORDF   &kp EQUAL     &kp ES_GRAVE  &kp ES_DQT    &kp ES_SQT    &kp ES_AMPS                                                                &kp ES_BSLH   &kp RA(SQT)   &kp RA(BSLH)  &kp ES_CARET  &kp ES_IQMARK &kp ES_UMLAUT
    // ├─────────────┼─────────────┼─────────────┼─────────────┼─────────────┼─────────────┼─────────────┬─────────────╮    ╭─────────────┬─────────────┼─────────────┼─────────────┼─────────────┼─────────────┼─────────────┼─────────────┤
         ___           &kp ES_MDOT   &kp ES_ACUTE  &kp ES_LT     &kp ES_GT     &kp ES_PIPE   XXX           XXX                XXX           XXX           &kp BSLH      &kp RA(LBKT)  &kp RA(RBKT)  &kp ES_TILDE  &kp ES_NOT    ___
    // ╰─────────────┴─────────────┴─────────────┼─────────────┼─────────────┼─────────────┼─────────────┼─────────────┤    ├─────────────┼─────────────┼─────────────┼─────────────┼─────────────┼─────────────┴─────────────┴─────────────╯
                                                   ___           ___           ___           ___           ___                ___           ___           ___           ___           ___
    //                                           ╰─────────────┴─────────────┴─────────────┴─────────────┴─────────────╯    ╰─────────────┴─────────────┴─────────────┴─────────────┴─────────────╯
)

// ---------------------------------------------------------------------------------------------------------------------------------
//  ╭─────┬─────┬─────┬─────┬─────┬─────╮                         ╭─────┬─────┬─────┬─────┬─────┬─────╮
//  |  ▼  |     |HOME |  ↑  | END |     |                         |  *  |  7  |  8  |  9  |     |  ▼  |
//  ├─────┼─────┼─────┼─────┼─────┼─────┤                         ├─────┼─────┼─────┼─────┼─────┼─────┤
//  |  ▼  |     |  ←  |  ↓  |  →  |     |                         |  +  |  4  |  5  |  6  |     |     |
//  ├─────┼─────┼─────┼─────┼─────┼─────┼─────┬─────╮ ╭─────┬─────┼─────┼─────┼─────┼─────┼─────┼─────┤
//  |  ▼  |     |     |     |     |     |     |     | |     |     |  0  |  1  |  2  |  3  |  .  |  ,  |
//  ╰─────┴─────┴─────┼─────┼─────┼─────┼─────┼─────┤ ├─────┼─────┼─────┼─────┼─────┼─────┴─────┴─────╯
//                    |  ▼  |  ▼  |  ▼  |  ▼  |  ▼  | |  ▼  |  ▼  |  ▼  |  ▼  |  ▼  |
//                    ╰─────┴─────┴─────┴─────┴─────╯ ╰─────┴─────┴─────┴─────┴─────╯
ZMK_LAYER(number_layer,
    // ╭─────────────┬─────────────┬─────────────┬─────────────┬─────────────┬─────────────╮                                                            ╭─────────────┬─────────────┬─────────────┬─────────────┬─────────────┬─────────────╮
         ___           XXX           &kp HOME      &kp UP        &kp END       XXX                                                                        &kp ES_STAR   &kp KP_N7     &kp KP_N8     &kp KP_N9     XXX           ___
    // ├─────────────┼─────────────┼─────────────┼─────────────┼─────────────┼─────────────┤                                                            ├─────────────┼─────────────┼─────────────┼─────────────┼─────────────┼─────────────┤
         ___           XXX           &kp LEFT      &kp DOWN      &kp RIGHT     XXX                                                                        &kp ES_PLUS  &hmr LCTRL KP_N4 &hmr LSHFT KP_N5 &hmr LALT KP_N6 XXX    XXX
    // ├─────────────┼─────────────┼─────────────┼─────────────┼─────────────┼─────────────┼─────────────┬─────────────╮    ╭─────────────┬─────────────┼─────────────┼─────────────┼─────────────┼─────────────┼─────────────┼─────────────┤
         ___           XXX           XXX           XXX           XXX           XXX           XXX           XXX                XXX           XXX           &kp KP_N0     &kp KP_N1     &kp KP_N2     &kp KP_N3     &kp ES_DOT    &kp ES_COMMA
    // ╰─────────────┴─────────────┴─────────────┼─────────────┼─────────────┼─────────────┼─────────────┼─────────────┤    ├─────────────┼─────────────┼─────────────┼─────────────┼─────────────┼─────────────┴─────────────┴─────────────╯
                                                   ___           ___           ___           ___           ___                ___           ___           ___           ___           ___
    //                                           ╰─────────────┴─────────────┴─────────────┴─────────────┴─────────────╯    ╰─────────────┴─────────────┴─────────────┴─────────────┴─────────────╯
)

// ---------------------------------------------------------------------------------------------------------------------------------
//  ╭─────┬─────┬─────┬─────┬─────┬─────╮                         ╭─────┬─────┬─────┬─────┬─────┬─────╮
//  | BLE | BT0 | BT1 | BT2 | BT3 | BT4 |                         | RGB | EF- | EF+ | SP- | SP+ | DEL |
//  ├─────┼─────┼─────┼─────┼─────┼─────┤                         ├─────┼─────┼─────┼─────┼─────┼─────┤
//  | USB | F1  | F2  | F3  | F4  | F5  |                         | F6  | F7  | F8  | F9  | F10 | PSC |
//  ├─────┼─────┼─────┼─────┼─────┼─────┼─────┬─────╮ ╭─────┬─────┼─────┼─────┼─────┼─────┼─────┼─────┤
//  |     | F11 |     |BTCLR| RST |     |     |     | |     |     | HU- | HU- | BR- | BR+ | F12 |N_LCK|
//  ╰─────┴─────┴─────┼─────┼─────┼─────┼─────┼─────┤ ├─────┼─────┼─────┼─────┼─────┼─────┴─────┴─────╯
//                    |  ▼  |  ▼  |  ▼  |  ▼  |  ▼  | |  ▼  |  ▼  |  ▼  |  ▼  |  ▼  |
//                    ╰─────┴─────┴─────┴─────┴─────╯ ╰─────┴─────┴─────┴─────┴─────╯
#define RGB_EFECT_KEYS &rgb_ug RGB_TOG &rgb_ug RGB_EFR &rgb_ug RGB_EFF &rgb_ug RGB_SPD &rgb_ug RGB_SPI
#define RGB_COLOR_KEYS &rgb_ug RGB_HUD &rgb_ug RGB_HUI &rgb_ug RGB_BRD &rgb_ug RGB_BRI
#define BT_SEL_KEYS &bt BT_SEL 0  &bt BT_SEL 1  &bt BT_SEL 2  &bt BT_SEL 3  &bt BT_SEL 4

#define BT_MODE &out OUT_BLE
#define USB_MODE &out OUT_USB

ZMK_LAYER(function_layer,
    // ╭─────────────┬─────────────┬─────────────┬─────────────┬─────────────┬─────────────╮                                                            ╭─────────────┬─────────────┬─────────────┬─────────────┬─────────────┬─────────────╮
         BT_MODE                                   BT_SEL_KEYS                                                                                                                      RGB_EFECT_KEYS                              &kp DEL 
    // ├─────────────┼─────────────┼─────────────┼─────────────┼─────────────┼─────────────┤                                                            ├─────────────┼─────────────┼─────────────┼─────────────┼─────────────┼─────────────┤
         USB_MODE      &kp F1        &kp F2        &kp F3        &kp F4        &kp F5                                                                     &kp 6         &kp F7        &kp F8        &kp F9        &kp F10       &kp PSCRN
    // ├─────────────┼─────────────┼─────────────┼─────────────┼─────────────┼─────────────┼─────────────┬─────────────╮    ╭─────────────┬─────────────┼─────────────┼─────────────┼─────────────┼─────────────┼─────────────┼─────────────┤
         XXX           &kp F11       XXX           &bt BT_CLR    &bootloader   XXX           XXX           XXX                XXX           XXX                                     RGB_COLOR_KEYS                &kp F12       &kp KP_NUM
   // ╰─────────────┴─────────────┴─────────────┼─────────────┼─────────────┼─────────────┼─────────────┼─────────────┤    ├─────────────┼─────────────┼─────────────┼─────────────┼─────────────┼─────────────┴─────────────┴─────────────╯
                                                   ___           ___           ___           ___           ___                ___           ___           ___           ___           ___
    //                                           ╰─────────────┴─────────────┴─────────────┴─────────────┴─────────────╯    ╰─────────────┴─────────────┴─────────────┴─────────────┴─────────────╯
)
